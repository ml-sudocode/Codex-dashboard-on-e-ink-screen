// Source: a QR code to this firmware's GitHub repo. Any button goes home.
#include <string.h>
#include "badge.h"

#define URL "github.com/yigitabi5444/supercon26-badge-os"

// QR version 4, error correction M, of "https://" URL: made once on a computer (python segno), '#' = dark module.
// ponytail: baked because the URL is fixed; regenerate if the repo moves.
static const char *const qr[33] = {
    "#######..#......#.#..##...#######",
    "#.....#.#######..#..#.....#.....#",
    "#.###.#.###.##.####..##...#.###.#",
    "#.###.#.#...#......###..#.#.###.#",
    "#.###.#....#...#..#..#.#..#.###.#",
    "#.....#..####.#.##...#..#.#.....#",
    "#######.#.#.#.#.#.#.#.#.#.#######",
    "........#.###..........##........",
    "#.....#.#.####.###.......##..###.",
    "##.##..#.#.##..##.##..##....####.",
    "####..#..##.#..##.#.###.###.#.##.",
    "#....#..##..#.#.#.......#########",
    "...#.##.##...######.#...#.##...##",
    ".###...##.##..#.##...#.#..##.####",
    ".#.#..###.#.......#.#.#..##.####.",
    "##.###.###.#####...##.#..#..###.#",
    "#.....#..###..#.##..#.####.###..#",
    "#.......#.###..#.#.##..#..#..####",
    "#..#..####...#.#...#...##..#.##.#",
    "..###..#.#...##..####.#...#.#####",
    "#...###.######..#..##.#.#..###.##",
    "###..#...##.....#.##..####.##.#..",
    "#.#.#.#....#..###...#...##.##.##.",
    "#....#.##.###.#...###.##.##..####",
    "###.#.#..###...##...#..#######.##",
    "........##.#.####.##...##...#.#.#",
    "#######..####.##..#.#####.#.#.#..",
    "#.....#........##......##...###.#",
    "#.###.#...###.##..##....######.#.",
    "#.###.#...##.##.#..###.###.######",
    "#.###.#...##....####...#.#.##.###",
    "#.....#..#.#...##...#.##...####..",
    "#######.#..###...#.#..#.#.##.#.#.",
};

void app_source(void)
{
    enum { N = 33, M = 13 }; // modules, px per module: 429 px square
    int x0 = (W - N * M) / 2, y0 = TOP + 48;
    memset(fb, 0, sizeof fb);
    for (int y = 0; y < N; y++)
        for (int x = 0; x < N; x++)
            if (qr[y][x] == '#') box(x0 + x * M, y0 + y * M, M, M, true);
    text((W - (int)strlen(URL) * 16) / 2, y0 + N * M + 40, 2, URL, true);
    ui_frame(1);
    ui_close();
    btn_get(-1);
}
